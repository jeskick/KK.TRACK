## receiver/pio/rx/sdkconfig.defaults
```kconfig
CONFIG_IDF_TARGET="esp32c3"
CONFIG_ESPTOOLPY_FLASHSIZE_4MB=y
# Console on schematic UART only: GPIO21 TX / GPIO20 RX (docs/HARDWARE.md), no USB-JTAG
CONFIG_ESP_CONSOLE_UART_CUSTOM=y
CONFIG_ESP_CONSOLE_UART_TX_GPIO=21
CONFIG_ESP_CONSOLE_UART_RX_GPIO=20
CONFIG_ESP_CONSOLE_UART_BAUDRATE=115200
CONFIG_ESP_CONSOLE_SECONDARY_NONE=y
CONFIG_ESP_CONSOLE_USB_SERIAL_JTAG_ENABLED=n

# Board has external TTL only; BLE RF cal can exceed 5s on single core
# PHY init data: use IDF built-in (partition mode needs separate phy_data.bin)
CONFIG_ESP_PHY_ENABLE_USB=n
CONFIG_ESP_TASK_WDT_CHECK_IDLE_TASK_CPU0=n

# PPM GPTimer ISR: GPIO/timer ctrl in IRAM (safe when BLE/NVS disables cache)
CONFIG_GPIO_CTRL_FUNC_IN_IRAM=y
CONFIG_GPTIMER_CTRL_FUNC_IN_IRAM=y
CONFIG_GPTIMER_ISR_IRAM_SAFE=y

# RX ~1MB; dual OTA slots 1700K (4MB flash). First time: pio run -t erase then upload.
# CONFIG_PARTITION_TABLE_TWO_OTA is not set
CONFIG_PARTITION_TABLE_TWO_OTA_LARGE=y
CONFIG_PARTITION_TABLE_FILENAME="partitions_two_ota_large.csv"
CONFIG_COMPILER_OPTIMIZATION_SIZE=y
CONFIG_LOG_DEFAULT_LEVEL_WARN=y

# OTA rollback until esp_ota_mark_app_valid_cancel_rollback()
CONFIG_BOOTLOADER_APP_ROLLBACK_ENABLE=y

CONFIG_HTTPD_MAX_URI_HANDLERS=12
CONFIG_HTTPD_TASK_STACK_SIZE=8192

CONFIG_BT_ENABLED=y
CONFIG_BT_NIMBLE_ENABLED=y
CONFIG_BT_CONTROLLER_ENABLED=y
CONFIG_BT_NIMBLE_MAX_CONNECTIONS=1
CONFIG_BT_NIMBLE_TASK_STACK_SIZE=8192
CONFIG_BT_NIMBLE_MSYS_1_BLOCK_COUNT=36
CONFIG_BT_NIMBLE_MSYS_2_BLOCK_COUNT=72
CONFIG_ESP_MAIN_TASK_STACK_SIZE=5120
CONFIG_ESP_SYSTEM_EVENT_TASK_STACK_SIZE=4096
CONFIG_BT_CTRL_DFT_TX_POWER_LEVEL_P6=y
CONFIG_BT_NIMBLE_ROLE_PERIPHERAL=y
CONFIG_BT_NIMBLE_ROLE_BROADCASTER=y
CONFIG_BT_NIMBLE_ROLE_CENTRAL=n
CONFIG_BT_NIMBLE_ROLE_OBSERVER=n
CONFIG_BT_NIMBLE_LL_CFG_FEAT_LE_ENCRYPTION=n
CONFIG_BT_NIMBLE_SECURITY_ENABLE=n

CONFIG_ESP_WIFI_ENABLED=y
```

## transmitter/pio/imu_test/sdkconfig.defaults
```kconfig
# KK-track TX ESP32-C3 + BNO085 SPI (board_tx.h)
CONFIG_IDF_TARGET="esp32c3"
CONFIG_ESPTOOLPY_FLASHSIZE_4MB=y

CONFIG_ESP_CONSOLE_UART_CUSTOM=y
CONFIG_ESP_CONSOLE_UART_TX_GPIO=21
CONFIG_ESP_CONSOLE_UART_RX_GPIO=20
CONFIG_ESP_CONSOLE_UART_BAUDRATE=115200
CONFIG_ESP_CONSOLE_SECONDARY_NONE=y
CONFIG_ESP_CONSOLE_USB_SERIAL_JTAG_ENABLED=n

CONFIG_ESP32_BNO08X_GPIO_HINT=3
CONFIG_ESP32_BNO08X_GPIO_RST=10
CONFIG_ESP32_BNO08X_GPIO_CS=7
CONFIG_ESP32_BNO08X_GPIO_SCL=4
CONFIG_ESP32_BNO08X_GPIO_DI=6
CONFIG_ESP32_BNO08X_GPIO_SDA=5
CONFIG_ESP32_BNO08X_GPIO_WAKE=-1
CONFIG_ESP32_BNO08x_SPI_HOST=1
CONFIG_ESP32_BNO08X_SCL_SPEED_HZ=1000000
CONFIG_ESP32_BNO08X_SPI_INTR_CPU_AFFINITY=0
CONFIG_ESP32_BNO08X_DATA_PROC_TASK_SZ=4096
```

## transmitter/pio/tx/sdkconfig.defaults
```kconfig
CONFIG_IDF_TARGET="esp32c3"
CONFIG_ESPTOOLPY_FLASHSIZE_4MB=y

# Same as RX / imu_test: schematic UART GPIO21/20 only, no USB-JTAG console
CONFIG_ESP_CONSOLE_UART_CUSTOM=y
CONFIG_ESP_CONSOLE_UART_TX_GPIO=21
CONFIG_ESP_CONSOLE_UART_RX_GPIO=20
CONFIG_ESP_CONSOLE_UART_BAUDRATE=115200
CONFIG_ESP_CONSOLE_SECONDARY_NONE=y
CONFIG_ESP_CONSOLE_USB_SERIAL_JTAG_ENABLED=n

CONFIG_ESP_PHY_ENABLE_USB=n
CONFIG_ESP_TASK_WDT_CHECK_IDLE_TASK_CPU0=n
CONFIG_ESP_INT_WDT_TIMEOUT_MS=1300

# CONFIG_PARTITION_TABLE_TWO_OTA is not set
CONFIG_PARTITION_TABLE_TWO_OTA_LARGE=y
CONFIG_PARTITION_TABLE_FILENAME="partitions_two_ota_large.csv"
CONFIG_COMPILER_OPTIMIZATION_SIZE=y
CONFIG_LOG_DEFAULT_LEVEL_WARN=y

# OTA rollback until esp_ota_mark_app_valid_cancel_rollback()
CONFIG_BOOTLOADER_APP_ROLLBACK_ENABLE=y

CONFIG_BT_ENABLED=y
CONFIG_BT_NIMBLE_ENABLED=y
CONFIG_BT_CONTROLLER_ENABLED=y
CONFIG_BT_NIMBLE_MAX_CONNECTIONS=1
CONFIG_BT_NIMBLE_TASK_STACK_SIZE=6144
CONFIG_BT_NIMBLE_MSYS_1_BLOCK_COUNT=64
CONFIG_BT_NIMBLE_MSYS_2_BLOCK_COUNT=72
CONFIG_BT_CTRL_DFT_TX_POWER_LEVEL_P6=y
CONFIG_BT_NIMBLE_ROLE_CENTRAL=y
CONFIG_BT_NIMBLE_ROLE_OBSERVER=y
CONFIG_BT_NIMBLE_ROLE_PERIPHERAL=n
CONFIG_BT_NIMBLE_ROLE_BROADCASTER=n
CONFIG_BT_NIMBLE_LL_CFG_FEAT_LE_ENCRYPTION=n
CONFIG_BT_NIMBLE_SECURITY_ENABLE=n

CONFIG_ESP_WIFI_ENABLED=n

# BNO085 SPI (board_tx.h / docs/IMU.md)
CONFIG_ESP32_BNO08X_GPIO_HINT=3
CONFIG_ESP32_BNO08X_GPIO_RST=10
CONFIG_ESP32_BNO08X_GPIO_CS=7
CONFIG_ESP32_BNO08X_GPIO_SCL=4
CONFIG_ESP32_BNO08X_GPIO_DI=6
CONFIG_ESP32_BNO08X_GPIO_SDA=5
CONFIG_ESP32_BNO08X_GPIO_WAKE=-1
CONFIG_ESP32_BNO08x_SPI_HOST=1
CONFIG_ESP32_BNO08X_SCL_SPEED_HZ=1000000
CONFIG_ESP32_BNO08X_SPI_INTR_CPU_AFFINITY=0
CONFIG_ESP32_BNO08X_DATA_PROC_TASK_SZ=6144

# --- nolog size test ---
CONFIG_LOG_DEFAULT_LEVEL_NONE=y
CONFIG_LOG_MAXIMUM_LEVEL=0
CONFIG_BOOTLOADER_LOG_LEVEL_NONE=y
CONFIG_ESP_CONSOLE_NONE=y
```
